## config/Kconfig
```kconfig
mainmenu "Ubuntu Live Boot Image Remaster Options"

config EXPERIMENTAL
  bool "Configure experimental or untested features"
  default n
  help

    Select yes here to allow configuring of features that haven't been
    fully tested or are experimental in nature.

config DEPRECATED
  bool "Configure deprecated options"
  default n
  help

    Select yes here to allow choosing configuration options which have
    been deprecated and will be going away.

source config/Kconfig.ubuntu
source config/Kconfig.target
source config/Kconfig.apt
source config/Kconfig.build
source config/Kconfig.applications
```

## config/Kconfig.apt
```kconfig
menu "APT package manager options"

config APT_PROXY
  string "APT proxy location"
  default ""
  help

    Configure an APT proxy server address.

    NOTE: This is only used during image *build*; the created image will not
    have this set.

    If in question leave this at the default.

endmenu
```

## config/Kconfig.build
```kconfig
menu "Software build options"

config USE_CCACHE
  bool "Add ccache to $PATH for compiling in root filesytem"
  default y
  help

    Select no here to turn off the use of ccache when compiling software
    in the chroot.

    If in question, say yes here.

config MAKEWIDTH
  string "Number of parallel make jobs"
  default "2"
  help

    Choose the number of parallel make jobs to use when invoking make. This
    should usually be the number of cores present in the machine.


endmenu
```

## config/Kconfig.iso
```kconfig
menu "Target ISO image options"

config REMASTER_SUFFIX
  string "Suffix to append to remastered ISO file"
  default "remastered"
  help

    Choose a string to be appended to the ISO file name to distinguish
    the binary from the original stock image ISO.

    If in question leave this at the default.

config ISO_UEFI
  bool "Create UEFI-compatible ISO image (EXPERIMENTAL)"
  depends on EXPERIMENTAL
  default n
  help

    Enable this to add an El-Torito alternate boot record pointing at
    an EFI boot loader image inside the ISO file.  This is
    experimental and not known to reliably work.

endmenu
```

## config/Kconfig.packages
```kconfig
menu "Package management options"

config APT_INSTALL_SOURCES
  bool "Install expanded APT repository list"
  default y
  help

    Select yes here to enable installing a new apt repository source
    file that includes the full set of Ubuntu repositories. If this is
    disabled, some installation options may not be available.

    If in question, say yes here.

config REMOVE_PACKAGES
  bool "Remove packages defined in config/remove-pkgs.d"
  default y
  help

    Select yes here to remove packages that have been specified in the
    config/remove-pkgs.d directory.  Saying no here may prevent other
    configuration choices from being available.

    If in question, say yes here.

config UPGRADE_PACKAGES
  bool "Upgrade packages in root filesystem"
  default y
  help

    Select yes here to upgrade apt packages in the root
    filesystem. This will happen after any packages configured for
    removal are purged. If the base ISO is too old, some later package
    installations might fail if this step is not performed.

    If in question, say yes here.

config INSTALL_PACKAGES
  bool "Install new packages as specified in config/install-pkgs.d"
  default y
  help

    Select yes here to install new packages into the system as specified
    in the config/install-pkgs.d directory.  If you say no here, some
    configuration options will become unavailable.

    If in question, say yes here.

endmenu
```

## config/Kconfig.tor
```kconfig
config TOR_PROXY
bool "Install Tor anonymizing network proxy"
depends on UBUNTU_RELEASE_TRUSTY
default n
help

  Installs the Tor anonymizing network proxy and allows configuration
  for manual, transparent, or isolating operation.

  If unsure, say no here.

choice
  prompt "Tor Proxy type"
  depends on TOR_PROXY
  help

    Choose how Tor will interact with network and application traffic.

    If unsure, choose "Manual operation".

  config TOR_PROXY_MANUAL
  bool "Manual operation"
  help

    Tor will be installed and make itself available for use by network
    applications, however, normal network traffic remains unaffected.

  config TOR_TRANS_PROXY
  bool "Transparent proxy"
  help

    Tor will be installed and all network TCP and DNS traffic will be
    automatically redirected to go over Tor. All non-TCP traffic will
    be silently dropped.

  config TOR_ISOLATING_PROXY
  bool "Isolating proxy"
  help

    Tor will be installed and network applications will need to be
    configured to use it.  All traffic not destined for Tor is
    silently dropped.

endchoice
```

## config/Kconfig.ubuntu
```kconfig
choice
  prompt "Ubuntu release version"
  help
    Selects the release version of the base ISO image
    to use for customization.

    If unsure, select "Ubuntu 14.04.4 LTS Desktop 64-bit"

  config UBUNTU_RELEASE_TRUSTY
    bool "Ubuntu 14.04.4 LTS Desktop 64-bit"
    help

      This is the Long Term Support version of Ubuntu Desktop, for use
      with either 32- or 64-bit CPUs.

  config UBUNTU_RELEASE_WILY
    bool "Ubuntu 15.10 Desktop 64-bit"
    depends on EXPERIMENTAL
    help

      This is the current latest release of Ubuntu Desktop, for use
      with either 32- or 64-bit CPUs.

endchoice

config UBUNTU_URL_BASE
  string
  default "http://releases.ubuntu.com"

config UBUNTU_URL_DIR
  string
  default "14.04" if UBUNTU_RELEASE_TRUSTY
  default "15.10" if UBUNTU_RELEASE_WILY

config UBUNTU_ISO_BASE
  string
  default ubuntu-14.04.4-desktop-amd64 if UBUNTU_RELEASE_TRUSTY
  default ubuntu-15.10-desktop-amd64 if UBUNTU_RELEASE_WILY
```
